## components/tts/Kconfig
```kconfig
menu "Audio TTS Configuration"

    config BAIDU_API_KEY
        string "BaiDu TTS API Key"
        default ""
        help
            API Key of baidu TTS Configuration.

    config BAIDU_SECRET_KEY
        string "BaiDu TTS Secret Key"
        default ""
        help
           Secret Key of baidu TTS Configuration.

endmenu
```

## examples/baidu-tts/main/Kconfig.projbuild
```kconfig
menu "Audio Example Configuration"

    config WIFI_SSID
        string "WiFi SSID"
        default "myssid"
        help
            SSID (network name) for the example to connect to.

    config WIFI_PASSWORD
        string "WiFi Password"
        default "mypassword"
        help
            WiFi password (WPA or WPA2) for the example to use.

            Can be left blank if the network has no security set.

    config API_KEY
        string "API Key"
        default ""
        help
            API Key of baidu TTS Configuration.

    config SECRET_KEY
        string "Secret Key"
        default ""
        help
           Secret Key of baidu TTS Configuration.

endmenu
```

## examples/put-picture-to-cos/main/Kconfig.projbuild
```kconfig
menu "Example Configuration"
    config WIFI_SSID
        string "WiFi SSID"
        default "myssid"
        help
            SSID (network name) for the example to connect to.

    config WIFI_PASSWORD
        string "WiFi Password"
        default "mypassword"
        help
            WiFi password (WPA or WPA2) for the example to use.
            Can be left blank if the network has no security set.

    menu "Tencent COS(Cloud Object Storage) Configuration"
        config TENCENT_COS_APPID
            string "Tencent APPID"
            default ""
            help
                Get APPID from https://console.cloud.tencent.com/developer

        config TECENT_COS_BUCKET_NAME
            string "Bucket Name"
            default ""
            help
                Get bucket name from https://console.cloud.tencent.com/cos5/bucket

        config TECENT_COS_BUCKET_AREA
            string "Bucket Area"
            default "ap-shanghai-fsi"
            help
                Get bucket area from https://console.cloud.tencent.com/cos5/bucket

        config TECENT_COS_ACCESS_SECRET_ID
            string "Access Secret ID"
            default ""
            help
                Get Secret ID from https://console.cloud.tencent.com/cam/capi

        config TECENT_COS_ACCESS_SECRET_KEY
            string "Access Secret Key"
            default ""
            help
                Get Secret Key from https://console.cloud.tencent.com/cam/capi

        config PPC_EXPIRE_S
            int "Config Expire Time(s)"
            range 30 600
            default 300
    endmenu
endmenu
```

## examples/put-picture-to-httpserver/main/Kconfig.projbuild
```kconfig
menu "Camera QR-Code Recognize"

menu "Example Config"
config APP_PRESS_GPIO
    int "GPIO_NUM_X(long press restore)"
    range 0 16
    default 0
    help
        Long press to restore WiFi information.

config APP_PRESS_FACTORY_INTERVAL_MS
    int "long press factory button interval(ms)"
    default 5000
    range 2000 8000
    help
        For restore WiFi information when long-press APP_PRESS_GPIO.

config APP_TRIGGER_CAPTURE_GPIO
    int "GPIO_NUM_X(short press trigger capture)"
    range 0 16
    default 0
    help
        Short press to trigger capture.

config APP_ANTI_SHAKE_TIME_MS
    int "anti-shake time(ms)"
    range 50 200
    default 100
    help
        Anti-shake time for long press.

config APP_GPIO_TASK_STACK
    int "APP GPIO task stack size"
    range 2048 4096
    default 2048
    help
        This task maintains GPIO state for long press and short press.

config APP_QIFI_TASK_STACK
    int "APP QiFi task stack size"
    range 32768 40960
    default 32768
    help
        This task maintains scan state and QiFi parser.

config APP_CAPTURE_TASK_STACK
    int "APP capture task stack size"
    range 2048 4096
    default 2048
    help
        This task maintains post capture state.

config APP_QIFI_PRINT_QR
        bool "printf QR code of WiFi"
        default y
        help
            Print QR code of WiFi if esp-camera scanned.

config APP_QIFI_CONNECT_TIMEOUT_MS
    int "APP WiFi connect timeout(ms)"
    range 10000 60000
    default 30000
    help
        WiFi connect timeout, once timeout, will entry scan state again.

config APP_POST_CAPTURE_INTERVAL_MS
    int "APP post capture timely(ms)"
    range 1000 60000
    default 30000
    help
        Every APP_POST_CAPTURE_INTERVAL_MS, will post capture to server.

config APP_HTTP_SERVER_URL
    string "http server url"
    default "http://192.168.3.63:8070"

endmenu

menu "Camera Pins"
choice CAMERA_MODEL
    bool "Select Camera Pinout"
    default CAMERA_MODEL_ESP_EYE
    help
        Select Camera Pinout.

config CAMERA_MODEL_WROVER_KIT
    bool "WROVER-KIT With OV2640 Module"
config CAMERA_MODEL_ESP_EYE
    bool "ESP_EYE DevKit"
config CAMERA_MODEL_M5STACK_PSRAM
    bool "M5Stack Camera With PSRAM"
config CAMERA_MODEL_AI_THINKER
    bool "ESP32-CAM by AI-Thinker"
config CAMERA_MODEL_CUSTOM
    bool "Custom Camera Pinout"
endchoice

config CAMERA_PIN_PWDN
    depends on CAMERA_MODEL_CUSTOM
    int "Power Down pin"
    range -1 33
    default -1
    help
        Select Power Down pin or -1 for unmanaged.

config CAMERA_PIN_RESET
    depends on CAMERA_MODEL_CUSTOM
    int "Reset pin"
    range -1 33
    default -1
    help
        Select Camera Reset pin or -1 for software reset.

config CAMERA_PIN_XCLK
    depends on CAMERA_MODEL_CUSTOM
    int "XCLK pin"
    range 0 33
    default 21
    help
        Select Camera XCLK pin.

config CAMERA_PIN_SIOD
    depends on CAMERA_MODEL_CUSTOM
    int "SIOD pin"
    range 0 33
    default 26
    help
        Select Camera SIOD pin.

config CAMERA_PIN_SIOC
    depends on CAMERA_MODEL_CUSTOM
    int "SIOC pin"
    range 0 33
    default 27
    help
        Select Camera SIOC pin.

config CAMERA_PIN_VSYNC
    depends on CAMERA_MODEL_CUSTOM
    int "VSYNC pin"
    range 0 39
    default 25
    help
        Select Camera VSYNC pin.

config CAMERA_PIN_HREF
    depends on CAMERA_MODEL_CUSTOM
    int "HREF pin"
    range 0 39
    default 23
    help
        Select Camera HREF pin.

config CAMERA_PIN_PCLK
    depends on CAMERA_MODEL_CUSTOM
    int "PCLK pin"
    range 0 39
    default 25
    help
        Select Camera PCLK pin.

config CAMERA_PIN_Y2
    depends on CAMERA_MODEL_CUSTOM
    int "Y2 pin"
    range 0 39
    default 4
    help
        Select Camera Y2 pin.

config CAMERA_PIN_Y3
    depends on CAMERA_MODEL_CUSTOM
    int "Y3 pin"
    range 0 39
    default 5
    help
        Select Camera Y3 pin.

config CAMERA_PIN_Y4
    depends on CAMERA_MODEL_CUSTOM
    int "Y4 pin"
    range 0 39
    default 18
    help
        Select Camera Y4 pin.

config CAMERA_PIN_Y5
    depends on CAMERA_MODEL_CUSTOM
    int "Y5 pin"
    range 0 39
    default 19
    help
        Select Camera Y5 pin.

config CAMERA_PIN_Y6
    depends on CAMERA_MODEL_CUSTOM
    int "Y6 pin"
    range 0 39
    default 36
    help
        Select Camera Y6 pin.

config CAMERA_PIN_Y7
    depends on CAMERA_MODEL_CUSTOM
    int "Y7 pin"
    range 0 39
    default 39
    help
        Select Camera Y7 pin.

config CAMERA_PIN_Y8
    depends on CAMERA_MODEL_CUSTOM
    int "Y8 pin"
    range 0 39
    default 34
    help
        Select Camera Y8 pin.

config CAMERA_PIN_Y9
    depends on CAMERA_MODEL_CUSTOM
    int "Y9 pin"
    range 0 39
    default 35
    help
        Select Camera Y9 pin.

endmenu

endmenu
```
